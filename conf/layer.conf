## conf/layer.conf
```bitbake
# We have a conf and classes directory, append to BBPATH
BBPATH .= ":${LAYERDIR}"

# We have a recipes directory, add to BBFILES
BBFILES += "${LAYERDIR}/recipes*/*/*.bb ${LAYERDIR}/recipes*/*/*.bbappend"

BBFILE_COLLECTIONS += "meta-elmo"
BBFILE_PATTERN_meta-elmo := "^${LAYERDIR}/"
BBFILE_PRIORITY_meta-elmo = "12"
```

## conf/machine/elmo.conf
```bitbake
#@TYPE: Machine
#@NAME: elmo machine
#@DESCRIPTION: Machine configuration for the prismcube.com 
TARGET_ARCH = "arm"

PREFERRED_PROVIDER_virtual/xserver = "xserver-xorg"
XSERVER = "xserver-xorg \
           xf86-input-evdev \
           xf86-input-mouse \
           xf86-video-fbdev \
           xf86-input-keyboard"

# Only has DVI connector for external screen
GUI_MACHINE_CLASS = "bigscreen"

require conf/machine/include/apollo.inc

PREFERRED_PROVIDER_virtual/kernel = "linux-apollo-elmo"

PREFERRED_PROVIDER_virtual/egl = "libgles-apollo"

IMAGE_FSTYPES += "ubi"
EXTRA_IMAGECMD_jffs2 = "-lnp "

# Guesswork
SERIAL_CONSOLE = "115200 ttyS1"

UBOOT_MACHINE = "omap3_beagle_config"

# do ubiattach /dev/ubi_ctrl -m 4
# From dmesg:
# UBI: smallest flash I/O unit:    2048
# UBI: logical eraseblock size:    129024 bytes
# from ubiattach stdout:
# UBI device number 0, total 1996 LEBs
MKUBIFS_ARGS="-m 2048 -e 126976 -c 4000"

# do ubiattach /dev/ubi_ctrl -m 4
# from dmesg:
# UBI: sub-page size:              512
UBINIZE_ARGS="-m 2048 -p 128KiB"


# and sdio
MACHINE_FEATURES = "kernel26 screen apm usbgadget usbhost vfat ext2"
MACHINE_FEATURES += "wifi"
MACHINE_FEATURES += "rt3070-legacy"

PREFERRED_VERSION_wpa-supplicant = "2.0"

require conf/machine/include/elmo-modules.inc

MACHINE_ESSENTIAL_EXTRA_RDEPENDS_append = " ${KERNEL_WIFI_MODULES} "

LINUX_LIBC_HEADERS_VERSION = "2.6.37"
PREFERRED_VERSION_linux-libc-headers = "2.6.37"
```

## conf/machine/include/apollo.inc
```bitbake
SOC_FAMILY = "omap3"
TARGET_ARCH = "arm"
inherit image_types_ubi

#require conf/machine/include/tune-cortexa9.inc
#require conf/machine/include/tune-cortexa8.inc
require conf/machine/include/tune-cortexa9apollo.inc
PREFERRED_PROVIDER_virtual/kernel ?= "linux-apollo-elmo"
# Increase this everytime you change something in the kernel
MACHINE_KERNEL_PR = "r101"

KERNEL_IMAGETYPE = "uImage"

UBOOT_ENTRYPOINT = "0x8000"
UBOOT_LOADADDRESS = "0x8000"
UBOOT_IMAGE = "u-boot-${MACHINE}.bin"
#EXTRA_IMAGEDEPENDS += "u-boot x-load"
EXTRA_IMAGEDEPENDS += "u-boot-2009.08"
```

## conf/machine/include/elmo-modules.inc
```bitbake
# Kernel Modules
#


KERNEL_WIFI_MODULES = " \
        kernel-module-rt73usb \
        kernel-module-rt2500usb \
        kernel-module-rtl8187 \
        kernel-module-zd1211rw \
        kernel-module-rt73usb \
        kernel-module-zd1211rw \
	r8192cu \
        ${@base_contains("MACHINE_FEATURES", "rt3070-legacy", "", "kernel-module-rt2800usb", d)} \
        "
#	kernel-module-w35und * 	kernel-module-r8192u-usb * 	kernel-module-ath9k-htc * 	kernel-module-prism2-usb * 	kernel-module-r8712u * 	kernel-module-rtl8192cu * 	kernel-module-carl9170 *
```

## conf/machine/include/tune-cortexa9apollo.inc
```bitbake
# apollo platform has no neon unit
#original
#TARGET_CC_ARCH = "-march=armv7-a -mtune=cortex-a9 -mfpu=vfpv3-d16 -mfloat-abi=softfp"
#BASE_PACKAGE_ARCH = "armv7a"
#FEED_ARCH = "armv7a"
#PACKAGE_EXTRA_ARCHS += "armv4 armv4t armv5te armv6 armv7 armv7a armv7a-vfp"

DEFAULTTUNE ?= "cortexa9"

require conf/machine/include/arm/arch-armv7a.inc

TUNEVALID[cortexa9] = "Enable Cortex-A9 specific processor optimizations"
TUNE_CCARGS += "${@bb.utils.contains("TUNE_FEATURES", "cortexa9", "-march=armv7-a -mtune=cortex-a9 -mfpu=vfpv3-d16 -mfloat-abi=softfp", "", d)}"

# Little Endian base configs
AVAILTUNES += "cortexa9"
TUNE_FEATURES_tune-cortexa9 = "${TUNE_FEATURES_tune-armv7a} cortexa9"
PACKAGE_EXTRA_ARCHS_tune-cortexa9 = "${PACKAGE_EXTRA_ARCHS_tune-armv7a}"

# VFP Tunes
AVAILTUNES += "cortexa9hf cortexa9thf cortexa9hf-neon"
TUNE_FEATURES_tune-cortexa9hf ?= "${TUNE_FEATURES_tune-armv7ahf} cortexa9"
TUNE_FEATURES_tune-cortexa9thf ?= "${TUNE_FEATURES_tune-armv7athf} cortexa9"
TUNE_FEATURES_tune-cortexa9hf-neon ?= "${TUNE_FEATURES_tune-armv7ahf-neon} cortexa9"
PACKAGE_EXTRA_ARCHS_tune-cortexa9hf = "${PACKAGE_EXTRA_ARCHS_tune-armv7ahf}"
PACKAGE_EXTRA_ARCHS_tune-cortexa9thf = "${PACKAGE_EXTRA_ARCHS_tune-armv7athf}"
PACKAGE_EXTRA_ARCHS_tune-cortexa9hf-neon = "${PACKAGE_EXTRA_ARCHS_tune-armv7ahf-neon}"
```
